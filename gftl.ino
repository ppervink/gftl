///////////////////////////////////////////////////////
//
//          >>>>  JUMBOTRON demo  <<<<
//
//
// Exercise the hardware from HackerBox #0036
//         which is avaiable at www.HackerBoxes.com
//
// Based on the PxMatrix library found here:
// https://github.com/2dom/PxMatrix
// The PxMatrix library is required for this dmeo.
//
///////////////////////////////////////////////////////
#include <PxMatrix.h>

// ESP32 Pins for JoyStick
#define JOY_X 35
#define JOY_Y 34
#define JOY_Z 26
#define KEY_1 27
#define KEY_2 32
#define KEY_3 33
#define KEY_4 25

// ESP32 Pins for LED MATRIX
#define P_LAT 22
#define P_A 19
#define P_B 23
#define P_C 18
#define P_D 5
#define P_E 15  // NOT USED for 1/16 scan
#define P_OE 2
hw_timer_t * timer = NULL;
portMUX_TYPE timerMux = portMUX_INITIALIZER_UNLOCKED;


PxMATRIX display(64, 32, P_LAT, P_OE, P_A, P_B, P_C, P_D);

bool AtTitleScreen = true;
bool WaitingForIdle = true;
uint8_t display_draw_time = 0;

uint8_t MaxLives = 3;
uint8_t TotalLaps = 5;
uint32_t Points = 0;

int KeyState = 0;
uint8_t CarX = 0;
uint8_t CarY = 0;

int CarAngle = 180;
uint8_t CurrentQuadrant = 1;
uint8_t CurrentLap = 0;
uint8_t RemainingLives = 0;

uint16_t* pTrackPixelColors = NULL;
uint16_t CarPixelColors[18] = {
  0, 0, 0, 0, 0, 0,
  0, 0, 0, 0, 0, 0,
  0, 0, 0, 0, 0, 0
};


// Some standard colors
uint16_t myRED = display.color565(255, 0, 0);
uint16_t myGREEN = display.color565(0, 255, 0);
uint16_t myBLUE = display.color565(0, 0, 255);
uint16_t myWHITE = display.color565(255, 255, 255);
uint16_t myYELLOW = display.color565(255, 255, 0);
uint16_t myCYAN = display.color565(0, 255, 255);
uint16_t myMAGENTA = display.color565(255, 0, 255);
uint16_t myBLACK = display.color565(0, 0, 0);
uint16_t CarColor = display.color565(31, 0, 0);
uint16_t TireColor = display.color565(30, 40, 30);

char TitlePixelData[64 * 32 * 3] = {
 0x00, 0x00, 0x00, 0x00, 0x00, 0x00, 0x00, 0x00, 0x00, 0x00, 0x00, 0x00,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 0x00,
  0x00, 0x00, 0x00, 0x00, 0x00, 0x00, 0x00, 0x00, 0x00, 0x00, 0x00, 0x00,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 0x00,
  0x00, 0x00, 0x00, 0x00, 0x00, 0x00, 0x00, 0x00, 0x00, 0xFF, 0x26, 0x00,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 0x00,
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  0x00, 0x00, 0x00, 0x00, 0x00, 0x00, 0x00, 0x00, 0x00, 0x00, 0x00, 0x00,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 0x00,
};

char TrackPixelData[64 * 32 * 3] = {
 0x0E, 0x7F, 0x00, 0x0E, 0x7F, 0x00, 0x0E, 0x7F, 0x00, 0x0E, 0x7F, 0x00,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 0x00,
  0x0E, 0x7F, 0x00, 0x0E, 0x7F, 0x00, 0x0E, 0x7F, 0x00, 0x0E, 0x7F, 0x00,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 0x00,
  0x0E, 0x7F, 0x00, 0x0E, 0x7F, 0x00, 0x0E, 0x7F, 0x00, 0x0E, 0x7F, 0x00,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 0x00,
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  0x0E, 0x7F, 0x00, 0x0E, 0x7F, 0x00, 0x0E, 0x7F, 0x00, 0x0E, 0x7F, 0x00,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 0x00,
};

void controlCar();
void resetCar();
void displayScreen();
void displayTitle();
void displayTrack();
void displayVictory();

void drawLap(uint8_t lapNumber, uint16_t color);
void drawCar(uint8_t x, uint8_t y);

void IRAM_ATTR display_updater() {
  // Increment the counter and set the time of ISR
  portENTER_CRITICAL_ISR(&timerMux);
  display.display(display_draw_time);
  portEXIT_CRITICAL_ISR(&timerMux);
}

void display_update_enable(bool is_enable)
{
  if (is_enable)
  {
    timer = timerBegin(0, 80, true);
    timerAttachInterrupt(timer, &display_updater, true);
    timerAlarmWrite(timer, 2000, true);
    timerAlarmEnable(timer);
  }
  else
  {
    timerDetachInterrupt(timer);
    timerAlarmDisable(timer);
  }
}

void setup()
{
  pinMode(JOY_Z, INPUT_PULLUP);
  pinMode(KEY_1, INPUT_PULLUP);
  pinMode(KEY_2, INPUT_PULLUP);
  pinMode(KEY_3, INPUT_PULLUP);
  pinMode(KEY_4, INPUT_PULLUP);
  display.begin(16); // 1/16 scan
  display.setFastUpdate(true);
  display_update_enable(true);

  pTrackPixelColors = new uint16_t[64 * 32];

  for (int y = 0, offset = 0; y < 32; y++)
  {
    for (int x = 0; x < 64; x++, offset += 3)
    {
      char b = TrackPixelData[offset];// * 31 / 255;
      char g = TrackPixelData[offset + 1];// *63 / 255;
      char r = TrackPixelData[offset + 2];// * 31 / 255;

      pTrackPixelColors[y * 64 + x] = display.color565(r, g, b);
    }
  }

  CarPixelColors[0] = TireColor;
  CarPixelColors[1] = TireColor;
  CarPixelColors[2] = CarColor;
  CarPixelColors[3] = CarColor;
  CarPixelColors[4] = TireColor;
  CarPixelColors[5] = TireColor;

  CarPixelColors[6] = CarColor;
  CarPixelColors[7] = CarColor;
  CarPixelColors[8] = CarColor;
  CarPixelColors[9] = CarColor;
  CarPixelColors[10] = CarColor;
  CarPixelColors[11] = CarColor;

  CarPixelColors[12] = TireColor;
  CarPixelColors[13] = TireColor;
  CarPixelColors[14] = CarColor;
  CarPixelColors[15] = CarColor;
  CarPixelColors[16] = TireColor;
  CarPixelColors[17] = TireColor;

  resetCar();
}

void loop()
{
  readKeys();
  controlCar();
  displayScreen();
  
  delay(10);
}

void readKeys()
{
  if (digitalRead(KEY_2) == LOW)
    KeyState = 2;
  else if (digitalRead(KEY_1) == LOW)
    KeyState = 1;
  else if (digitalRead(KEY_3) == LOW)
    KeyState = 3;
  else if (digitalRead(KEY_4) == LOW)
    KeyState = 4;
  else {
    KeyState = 0;
    WaitingForIdle = false;
  }
}

void resetCar() 
{
  CurrentQuadrant = 1;
  CarAngle = 180;
  
  if(RemainingLives == 0)
  {   
    for (int x = 0; x < TotalLaps; x++)
    {
      drawLap(x, myBLACK);
    }

    for(int x = 1; x <= MaxLives; x++){
      drawLap(15 - x, myRED);
    }

    AtTitleScreen = true;
    Points = 0;
    CurrentLap = 0;
    RemainingLives = MaxLives;
  }
  else 
  {
    drawLap(15 - RemainingLives, pTrackPixelColors[0]);
    RemainingLives--;
    Points = Points / 2;
  }
  
  drawCar(40, 3);
}

void controlCar() {

  if(WaitingForIdle)
    return;
    
  if(AtTitleScreen){
    if (KeyState != 0) {
      RemainingLives = 0;
      resetCar();
      AtTitleScreen = false;
      WaitingForIdle = true;
    }
  }
  else if (CurrentLap == TotalLaps) {
    if (KeyState !=0) {
      RemainingLives = 0;
      AtTitleScreen = true;
      WaitingForIdle = true;
    }
  }
  else {
    int wheel;;
    int angle;
    wheel = (33 * analogRead(JOY_X)) / 4096;

    if (wheel >= 22)
    {
      // LEFT
      angle = (((int)CarAngle + 360) - 5) % 360;
    }
    else if (wheel <= 11)
    {
      angle = ((int)CarAngle + 5) % 360;
    }
    else
    {
      angle = (int)CarAngle;
    }

    uint8_t carX = CarX;
    uint8_t carY = CarY;
    
    if (KeyState == 3)
    {
      CarAngle = angle;
      
      int rem = angle % 45;
      if (rem != 0)
        angle -= rem;

      switch (angle)
      {
        case 0:
          if (carX < 57)
            carX++;
          break;

        case 45:
          if (carX < 57)
            carX++;

          if (carY > 0)
            carY--;
          break;

        case 90:
          if (carY > 0)
            carY--;
          break;

        case 135:
          if (carY > 0)
            carY--;

          if (carX > 0)
            carX--;
          break;

        case 180:
          if (carX > 0)
            carX--;
          break;

        case 225:
          if (carX > 0)
            carX--;

          if (carY < 28)
            carY++;
          break;

        case 270:
          if (carY < 28)
            carY++;
          break;

        case 315:
          if (carX < 57)
            carX++;

          if (carY < 28)
            carY++;
          break;
      };
    }

    drawCar(carX, carY);
  }
}

void drawLap(uint8_t lapNumber, uint16_t color) {
  pTrackPixelColors[14 * 64 + (lapNumber * 2 + 18)] = color;
  pTrackPixelColors[15 * 64 + (lapNumber * 2 + 18)] = color;          
  pTrackPixelColors[16 * 64 + (lapNumber * 2 + 18)] = color;
}

void drawCar(uint8_t x, uint8_t y) {

  if (CarX == x && CarY == y)
    return;

  for (int x2 = 0; x2 < 6; x2++) {
    for (int y2 = 0; y2 < 3; y2++) {

      int offset = (CarY + y2) * 64 * 3 + ((CarX + x2) * 3);

      char b = TrackPixelData[offset];
      char g = TrackPixelData[offset + 1];
      char r = TrackPixelData[offset + 2];

      pTrackPixelColors[(CarY + y2) * 64 + (CarX + x2)] = display.color565(r, g, b);
    }
  }

  bool crashed = false;  
  for (int x2 = 0; x2 < 6; x2++) {
    for (int y2 = 0; y2 < 3; y2++) {

      int offset = (y + y2) * 64 + (x + x2);
      uint16_t color = pTrackPixelColors[offset];

      if (color == pTrackPixelColors[0])
        crashed = true;
      
      color = CarPixelColors[y2 * 6 + x2];
      pTrackPixelColors[offset] = color;
    }
  }

  CarX = x;
  CarY = y;

  if (crashed) {    
    resetCar();    
    WaitingForIdle = true;
  }
  else {
    switch (CurrentQuadrant) {
      case 0:
        if (x < 32 && y < 16) {
          CurrentQuadrant++;
          drawLap(CurrentLap, myWHITE);
          CurrentLap++;
          
          if(CurrentLap == TotalLaps)            
            WaitingForIdle = true;
        }
        break;

      case 1:
        if (x < 32 && y > 16)
          CurrentQuadrant++;
        break;

      case 2:
        if (x > 32 && y > 16)
          CurrentQuadrant++;
        break;

      case 3:
        if (x > 32 && y < 16)
           CurrentQuadrant = 0;
        break;
    };

    Points += (RemainingLives + 1) * (CurrentLap + 1);
  }
}

void displayTitle() {
  for (int y = 0, offset = 0; y < 32; y++)
  {
    for (int x = 0; x < 64; x++, offset += 3)
    {
      char b = TitlePixelData[offset];
      char g = TitlePixelData[offset + 1];
      char r = TitlePixelData[offset + 2];

      display.drawPixel(x, y, display.color565(r, g, b));
    }
  }
}

void displayVictory(){
  display.clearDisplay();
  display.drawLine(0, 0, 63, 0, myYELLOW);
  display.drawLine(0, 31, 63, 31, myYELLOW);
  display.drawLine(0, 1, 0, 30, myBLUE);
  display.drawLine(63, 1, 63, 30, myBLUE);
  display.setTextColor(myWHITE);
  display.setCursor(10, 6);
  display.println("You Win");
  display.setTextColor(myGREEN);
  display.print("  ");
  display.print(Points);
  display.print("pts");
}

void displayTrack()
{
  for (int y = 0; y < 32; y++)
  {
    for (int x = 0; x < 64; x++)
    {
      uint16_t color = pTrackPixelColors[y * 64 + x];

      display.drawPixel(x, y, color);
    }
  }
}

void displayScreen()
{
  if(AtTitleScreen){
    displayTitle();
  }
  else if (CurrentLap < TotalLaps)
  {
    displayTrack();
  }
  else {
    displayVictory();
  }
}
